## esp-idf/sdkconfig.defaults
```kconfig
CONFIG_FREERTOS_HZ=1000
CONFIG_AUTOSTART_ARDUINO=y
CONFIG_COMPILER_OPTIMIZATION_SIZE=y
CONFIG_BT_ENABLED=n
CONFIG_ESP_RMAKER_ENABLED=n
CONFIG_ENABLE_ESP_MATTER=n
CONFIG_ESP_INSIGHTS_ENABLED=n
CONFIG_PARTITION_TABLE_CUSTOM_FILENAME="partitions.csv"
```
